#include "Untitled.dtsi" // The shared dtsi file is included in the overlay

// Label of the kscan node in the dtsi
&kscan0 {
    col-gpios
        = <&gpio0 5 (GPIO_ACTIVE_HIGH | GPIO_PULL_DOWN)>
        ,<&gpio0 0 (GPIO_ACTIVE_HIGH | GPIO_PULL_DOWN)>
        ,<&gpio0 30 (GPIO_ACTIVE_HIGH | GPIO_PULL_DOWN)>
        ,<&gpio0 3 (GPIO_ACTIVE_HIGH | GPIO_PULL_DOWN)>
        ,<&gpio0 46 (GPIO_ACTIVE_HIGH | GPIO_PULL_DOWN)>
        ,<&gpio0 47 (GPIO_ACTIVE_HIGH | GPIO_PULL_DOWN)>
        ,<&gpio0 10 (GPIO_ACTIVE_HIGH | GPIO_PULL_DOWN)>
        ;
};
