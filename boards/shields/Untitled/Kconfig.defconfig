## boards/shields/Untitled/Kconfig.defconfig
```kconfig
if SHIELD_Untitled_LEFT

# Name must be less than 16 characters long!
config ZMK_KEYBOARD_NAME
    default "Untitled"

config ZMK_SPLIT_ROLE_CENTRAL
    default y

endif

if SHIELD_Untitled_LEFT || SHIELD_Untitled_RIGHT

config ZMK_SPLIT
    default y

endif
```

## boards/shields/Untitled/Kconfig.shield
```kconfig
# No whitespace after the comma or in your part name!
config SHIELD_Untitled_LEFT
    def_bool $(shields_list_contains,Untitled_left)

# No whitespace after the comma or in your part name!
config SHIELD_Untitled_RIGHT
    def_bool $(shields_list_contains,Untitled_right)
```
